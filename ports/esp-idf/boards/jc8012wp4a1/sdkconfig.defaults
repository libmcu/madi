## ports/esp-idf/boards/jc8012wp4a1/sdkconfig.defaults
```kconfig
CONFIG_IDF_TARGET="esp32p4"
CONFIG_IDF_EXPERIMENTAL_FEATURES=y

# ESP32-P4 rev v1.x compatibility profile
CONFIG_ESP32P4_SELECTS_REV_LESS_V3=y
CONFIG_ESP32P4_REV_MIN_100=y

CONFIG_ESPTOOLPY_FLASHSIZE_16MB=y
CONFIG_ESPTOOLPY_FLASHMODE_QIO=y
CONFIG_SPI_FLASH_SUPPORT_BOYA_CHIP=y

CONFIG_PARTITION_TABLE_CUSTOM=y
CONFIG_PARTITION_TABLE_CUSTOM_FILENAME="ports/esp-idf/partitions_16mb.csv"
CONFIG_PARTITION_TABLE_FILENAME="ports/esp-idf/partitions_16mb.csv"

CONFIG_SPIRAM=y
CONFIG_SPIRAM_BOOT_INIT=y
CONFIG_SPIRAM_USE_MALLOC=y
CONFIG_SPIRAM_MEMTEST=y
CONFIG_SPIRAM_SPEED_200M=y
CONFIG_SPIRAM_SPEED=200

CONFIG_ESP_DEFAULT_CPU_FREQ_MHZ_360=y
CONFIG_ESP_DEFAULT_CPU_FREQ_MHZ=360

CONFIG_FREERTOS_HZ=1000
CONFIG_ESP_MAIN_TASK_STACK_SIZE=5632
CONFIG_BOOTLOADER_APP_ROLLBACK_ENABLE=y

CONFIG_ESP_WIFI_REMOTE_ENABLED=y
CONFIG_ESP_WIFI_REMOTE_LIBRARY_HOSTED=y
CONFIG_SLAVE_IDF_TARGET_ESP32C6=y
CONFIG_ESP_HOSTED_IDF_SLAVE_TARGET="esp32c6"
CONFIG_ESP_HOSTED_HOST_TO_ESP_WIFI_DATA_THROTTLE=y
```

## ports/esp-idf/boards/madi_esp32s3/sdkconfig.defaults
```kconfig
CONFIG_IDF_TARGET="esp32s3"
CONFIG_IDF_EXPERIMENTAL_FEATURES=y

CONFIG_ESPTOOLPY_FLASHSIZE_8MB=y

CONFIG_PARTITION_TABLE_CUSTOM=y
CONFIG_PARTITION_TABLE_CUSTOM_FILENAME="ports/esp-idf/partitions_8mb.csv"
CONFIG_PARTITION_TABLE_FILENAME="ports/esp-idf/partitions_8mb.csv"
CONFIG_PARTITION_TABLE_OFFSET=0xE000

CONFIG_FREERTOS_HZ=1000
CONFIG_ESP_MAIN_TASK_STACK_SIZE=5632
CONFIG_BOOTLOADER_APP_ROLLBACK_ENABLE=y

# Make USB-Serial-JTAG the primary console so stdin/stdout use /dev/tty.usbmodem*
CONFIG_ESP_CONSOLE_USB_SERIAL_JTAG=y
CONFIG_ESP_CONSOLE_SECONDARY_NONE=y
```

## ports/esp-idf/sdkconfig.defaults
```kconfig
CONFIG_PARTITION_TABLE_CUSTOM=y
CONFIG_PARTITION_TABLE_CUSTOM_FILENAME="ports/esp-idf/partitions.csv"
CONFIG_PARTITION_TABLE_FILENAME="ports/esp-idf/partitions.csv"

CONFIG_ESPTOOLPY_FLASHSIZE_4MB=y

CONFIG_LWIP_LOCAL_HOSTNAME="libmcu"
```

## ports/zephyr/boards/nordic/madi_nrf52840/Kconfig.defconfig
```kconfig
# SPDX-License-Identifier: MIT

if BOARD_MADI_NRF52840

config HW_STACK_PROTECTION
	default ARCH_HAS_STACK_PROTECTION

endif # BOARD_MADI_NRF52840
```

## ports/zephyr/boards/nordic/madi_nrf52840/Kconfig.madi_nrf52840
```kconfig
# SPDX-License-Identifier: MIT

config BOARD_MADI_NRF52840
	select SOC_NRF52840_QIAA
```

## ports/zephyr/boards/nordic/madi_nrf52840/board.yml
```yaml
board:
  name: madi_nrf52840
  full_name: MADI nRF52840
  vendor: nordic
  socs:
    - name: nrf52840
```

## ports/zephyr/boards/nordic/madi_nrf52840/madi_nrf52840_defconfig
```kconfig
# SPDX-License-Identifier: MIT

# nRF52840 MPU
CONFIG_ARM_MPU=y

# GPIO subsystem
CONFIG_GPIO=y

# Pin control (mandatory for nRF52840 peripherals)
CONFIG_PINCTRL=y
```

## sysbuild/mcuboot/boards/madi_nrf52840.conf
```kconfig
#
# SPDX-License-Identifier: MIT
#
# MCUboot board-specific configuration for madi_nrf52840.
# Follows the pattern of:
#   samples/matter/template/sysbuild/mcuboot/boards/nrf52840dk_nrf52840.conf
#
# This enables the QSPI NOR flash driver required to access the external
# MX25R1635F (Slot 1 / secondary OTA slot) from within MCUboot.

CONFIG_NORDIC_QSPI_NOR=y
# MX25R1635F minimum erase unit is 4 KiB (sector erase command 0x20).
# The default 65536 (64 KiB block) does not divide 976 KiB evenly.
CONFIG_NORDIC_QSPI_NOR_FLASH_LAYOUT_PAGE_SIZE=4096
CONFIG_NORDIC_QSPI_NOR_STACK_WRITE_BUFFER_SIZE=16
```
